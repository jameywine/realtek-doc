## sources/rtk-sg3210x/sdk/config/Kconfig
```kconfig
#############################################################################

mainmenu "SDK Configuration"

source "./Kconfig.sdk"

#############################################################################
```
